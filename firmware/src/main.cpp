// Benairy wind tunnel controller, ESP32 (Arduino framework). Schreiber AI.
// Access point "Benairy" / "windtunnel", dashboard at http://192.168.4.1
#include <Arduino.h>
#include <WiFi.h>
#include <WebServer.h>
#include <Wire.h>
#include <Preferences.h>
#include <esp_task_wdt.h>
#include "config.h"
#include "controller.h"
#include "dashboard_html.h"   // generated by tools/embed_dashboard.py

#if ESP_ARDUINO_VERSION_MAJOR >= 3
#define LEDC_V3 1
#else
#define LEDC_V3 0
#endif

// ---------------------------------------------------------------- HX711 driver
class HX711 {
public:
    HX711(int dt, int sck) : dt_(dt), sck_(sck) {}
    void begin() { pinMode(dt_, INPUT); pinMode(sck_, OUTPUT); digitalWrite(sck_, LOW); }
    bool ready() { return digitalRead(dt_) == LOW; }
    int32_t read() {   // channel A, gain 128
        uint32_t v = 0;
        noInterrupts();
        for (int i = 0; i < 24; ++i) {
            digitalWrite(sck_, HIGH); delayMicroseconds(1);
            v = (v << 1) | digitalRead(dt_);
            digitalWrite(sck_, LOW); delayMicroseconds(1);
        }
        digitalWrite(sck_, HIGH); delayMicroseconds(1); digitalWrite(sck_, LOW);
        interrupts();
        if (v & 0x800000) v |= 0xFF000000;
        return (int32_t)v;
    }
private:
    int dt_, sck_;
};

// ---------------------------------------------------------------- tach
static volatile uint32_t g_tach_pulses = 0;
static void IRAM_ATTR tach_isr() { g_tach_pulses++; }

// ---------------------------------------------------------------- ESP32 HAL
class Esp32Hal : public Hal {
public:
    HX711 lift{PIN_HX_LIFT_DT, PIN_HX_LIFT_SCK}, drag{PIN_HX_DRAG_DT, PIN_HX_DRAG_SCK};
    bool sdp_ok = false, as_ok = false;
    float rpm = 0; uint32_t last_rpm_ms = 0; uint32_t last_pulses = 0;
    uint32_t last_i2c_ms = 0; float dp = 0, temp = 20; float aoa = 0;

    void begin() {
        pinMode(PIN_ESTOP, INPUT_PULLUP);
        pinMode(PIN_STATUS_LED, OUTPUT);
        pinMode(PIN_FAN_TACH, INPUT_PULLUP);
        attachInterrupt(digitalPinToInterrupt(PIN_FAN_TACH), tach_isr, FALLING);
        lift.begin(); drag.begin();
        Wire.begin(PIN_I2C_SDA, PIN_I2C_SCL, 400000);
#if LEDC_V3
        ledcAttach(PIN_FAN_PWM, FAN_PWM_HZ, FAN_PWM_BITS);
        ledcAttach(PIN_SERVO, 50, 16);
#else
        ledcSetup(0, FAN_PWM_HZ, FAN_PWM_BITS); ledcAttachPin(PIN_FAN_PWM, 0);
        ledcSetup(1, 50, 16); ledcAttachPin(PIN_SERVO, 1);
#endif
        set_fan(0); set_servo_deg(0);
        // SDP810: start continuous differential pressure measurement with averaging
        Wire.beginTransmission(ADDR_SDP810); Wire.write(0x36); Wire.write(0x15);
        sdp_ok = (Wire.endTransmission() == 0);
        Wire.beginTransmission(ADDR_AS5600); as_ok = (Wire.endTransmission() == 0);
        log(sdp_ok ? "SDP810 found" : "SDP810 NOT found");
        log(as_ok ? "AS5600 found" : "AS5600 NOT found");
    }
    void read(SensorFrame &f) override {
        if (lift.ready()) { f.lift_raw = lift.read(); f.lift_ok = true; }
        if (drag.ready()) { f.drag_raw = drag.read(); f.drag_ok = true; }
        uint32_t now = ::millis();
        if (now - last_i2c_ms >= 50) {          // 20 Hz for the I2C sensors
            last_i2c_ms = now;
            if (sdp_ok && Wire.requestFrom(ADDR_SDP810, 9) == 9) {
                uint8_t b[9]; for (int i = 0; i < 9; ++i) b[i] = Wire.read();
                int16_t dpr = (int16_t)((b[0] << 8) | b[1]);
                int16_t tr = (int16_t)((b[3] << 8) | b[4]);
                int16_t scale = (int16_t)((b[6] << 8) | b[7]);
                if (scale != 0) { dp = (float)dpr / scale; temp = tr / 200.0f; f.dp_ok = true; }
            }
            if (as_ok) {
                Wire.beginTransmission(ADDR_AS5600); Wire.write(0x0C);
                if (Wire.endTransmission(false) == 0 && Wire.requestFrom(ADDR_AS5600, 2) == 2) {
                    uint16_t raw = ((Wire.read() & 0x0F) << 8) | Wire.read();
                    aoa = raw * 360.0f / 4096.0f; f.aoa_ok = true;
                }
            }
        }
        f.dp_pa = dp; f.temp_c = temp; f.aoa_raw_deg = aoa;
        if (now - last_rpm_ms >= 500) {
            uint32_t p = g_tach_pulses; uint32_t d = p - last_pulses; last_pulses = p;
            rpm = d * (60000.0f / (now - last_rpm_ms)) / FAN_TACH_PULSES_PER_REV; last_rpm_ms = now;
        }
        f.fan_rpm = rpm;
        f.vbus_v = analogReadMilliVolts(PIN_VBUS_ADC) * (57.0f / 10.0f) / 1000.0f;
        f.estop_open = (digitalRead(PIN_ESTOP) == HIGH);
    }
    void set_fan(float d) override {
        uint32_t v = (uint32_t)(d * ((1 << FAN_PWM_BITS) - 1));
#if LEDC_V3
        ledcWrite(PIN_FAN_PWM, v);
#else
        ledcWrite(0, v);
#endif
    }
    void set_servo_deg(float deg) override {
        deg = constrain(deg, -80.0f, 80.0f);
        float us = 1500.0f + deg * (1000.0f / 90.0f);        // 500..2500 us over +-90
        uint32_t duty = (uint32_t)(us / 20000.0f * 65535.0f);
#if LEDC_V3
        ledcWrite(PIN_SERVO, duty);
#else
        ledcWrite(1, duty);
#endif
    }
    void set_led(bool on) override { digitalWrite(PIN_STATUS_LED, on); }
    uint32_t millis() override { return ::millis(); }
    void log(const char *m) override { Serial.println(m); }
};

static Esp32Hal hal;
static Controller ctl(hal);
static WebServer server(80);
static Preferences prefs;

static void save_config() {
    prefs.begin("benairy", false);
    prefs.putBytes("cfg", &ctl.config(), sizeof(Config));
    prefs.end();
}
static void load_config() {
    prefs.begin("benairy", true);
    if (prefs.getBytesLength("cfg") == sizeof(Config)) prefs.getBytes("cfg", &ctl.config_mut(), sizeof(Config));
    prefs.end();
}

static std::vector<float> parse_list(const String &s) {
    std::vector<float> v; int start = 0;
    while (start < (int)s.length()) {
        int c = s.indexOf(',', start); if (c < 0) c = s.length();
        String tok = s.substring(start, c); tok.trim();
        if (tok.length()) v.push_back(tok.toFloat());
        start = c + 1;
    }
    return v;
}

static void handle_cmd() {
    ctl.client_seen();
    String cmd = server.arg("cmd"); std::string r = "unknown command";
    if (cmd == "fan") r = ctl.cmd_fan(server.arg("value").toFloat());
    else if (cmd == "aoa") r = ctl.cmd_aoa(server.arg("value").toFloat());
    else if (cmd == "tare") r = ctl.cmd_tare();
    else if (cmd == "zero_aoa") { r = ctl.cmd_zero_aoa(); save_config(); }
    else if (cmd == "stop") r = ctl.cmd_stop();
    else if (cmd == "clear_faults") r = ctl.cmd_clear_faults();
    else if (cmd == "set") { r = ctl.set_config(server.arg("key").c_str(), server.arg("value").toFloat()); save_config(); }
    else if (cmd == "sweep") {
        SweepSpec s; s.aoas = parse_list(server.arg("list")); s.fan = server.arg("fan").toFloat();
        if (server.hasArg("settle")) s.settle_s = server.arg("settle").toFloat();
        if (server.hasArg("samples")) s.samples = (uint16_t)server.arg("samples").toInt();
        s.up_and_down = server.arg("updown") == "1";
        r = ctl.cmd_sweep(s);
    }
    server.send(r == "ok" || r.rfind("taring", 0) == 0 || r == "stopped" ? 200 : 400, "text/plain", r.c_str());
}

void setup() {
    Serial.begin(115200);
    hal.begin();
    load_config();
    WiFi.mode(WIFI_AP);
    WiFi.softAP(WIFI_AP_SSID, WIFI_AP_PASS);
    server.on("/", HTTP_GET, []() {
        server.sendHeader("Content-Encoding", "gzip");
        server.send_P(200, "text/html", (const char *)DASHBOARD_HTML_GZ, DASHBOARD_HTML_GZ_LEN);
    });
    server.on("/api/status", HTTP_GET, []() { ctl.client_seen(); server.send(200, "application/json", ctl.telemetry_json().c_str()); });
    server.on("/api/samples", HTTP_GET, []() { ctl.client_seen(); server.send(200, "application/json", ctl.samples_json((uint32_t)server.arg("since").toInt()).c_str()); });
    server.on("/api/config", HTTP_GET, []() { server.send(200, "application/json", ctl.config_json().c_str()); });
    server.on("/api/sweep.csv", HTTP_GET, []() { server.send(200, "text/csv", ctl.sweep_csv().c_str()); });
    server.on("/api/sweep.json", HTTP_GET, []() { server.send(200, "application/json", ctl.sweep_json().c_str()); });
    server.on("/api/cmd", HTTP_POST, handle_cmd);
    server.on("/api/info", HTTP_GET, []() {
        server.send(200, "application/json", String("{\"name\":\"Benairy\",\"vendor\":\"Schreiber AI\",\"fw\":\"") + BENAIRY_FW_VERSION + "\",\"sim\":false}");
    });
    server.begin();
    esp_task_wdt_init(5, true);      // reboot if the loop stalls for 5 s
    esp_task_wdt_add(NULL);
    Serial.println("Benairy ready. AP: " WIFI_AP_SSID "  http://192.168.4.1");
}

void loop() {
    static uint32_t next = 0;
    uint32_t now = millis();
    if ((int32_t)(now - next) >= 0) { next = now + 1000 / TICK_HZ; ctl.tick(); }
    server.handleClient();
    esp_task_wdt_reset();
    delay(1);
}
